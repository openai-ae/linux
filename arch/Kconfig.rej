## arch/x86/Kconfig.rej
```kconfig
--- arch/x86/Kconfig
+++ arch/x86/Kconfig
@@ -525,216 +525,7 @@ config X86_FRED
 	  ring transitions and exception/interrupt handling if the
 	  system supports it.
 
-config X86_BIGSMP
-	bool "Support for big SMP systems with more than 8 CPUs"
-	depends on SMP && X86_32
-	help
-	  This option is needed for the systems that have more than 8 CPUs.
-
-config X86_EXTENDED_PLATFORM
-	bool "Support for extended (non-PC) x86 platforms"
-	default y
-	help
-	  If you disable this option then the kernel will only support
-	  standard PC platforms. (which covers the vast majority of
-	  systems out there.)
-
-	  If you enable this option then you'll be able to select support
-	  for the following non-PC x86 platforms, depending on the value of
-	  CONFIG_64BIT.
-
-	  32-bit platforms (CONFIG_64BIT=n):
-		Goldfish (Android emulator)
-		AMD Elan
-		RDC R-321x SoC
-		SGI 320/540 (Visual Workstation)
-		STA2X11-based (e.g. Northville)
-		Moorestown MID devices
-
-	  64-bit platforms (CONFIG_64BIT=y):
-		Numascale NumaChip
-		ScaleMP vSMP
-		SGI Ultraviolet
-
-	  If you have one of these systems, or if you want to build a
-	  generic distribution kernel, say Y here - otherwise say N.
-
-# This is an alphabetically sorted list of 64 bit extended platforms
-# Please maintain the alphabetic order if and when there are additions
-config X86_NUMACHIP
-	bool "Numascale NumaChip"
-	depends on X86_64
-	depends on X86_EXTENDED_PLATFORM
-	depends on NUMA
-	depends on SMP
-	depends on X86_X2APIC
-	depends on PCI_MMCONFIG
-	help
-	  Adds support for Numascale NumaChip large-SMP systems. Needed to
-	  enable more than ~168 cores.
-	  If you don't have one of these, you should say N here.
-
-config X86_VSMP
-	bool "ScaleMP vSMP"
-	select HYPERVISOR_GUEST
-	select PARAVIRT
-	depends on X86_64 && PCI
-	depends on X86_EXTENDED_PLATFORM
-	depends on SMP
-	help
-	  Support for ScaleMP vSMP systems.  Say 'Y' here if this kernel is
-	  supposed to run on these EM64T-based machines.  Only choose this option
-	  if you have one of these machines.
-
-config X86_UV
-	bool "SGI Ultraviolet"
-	depends on X86_64
-	depends on X86_EXTENDED_PLATFORM
-	depends on NUMA
-	depends on EFI
-	depends on KEXEC_CORE
-	depends on X86_X2APIC
-	depends on PCI
-	help
-	  This option is needed in order to support SGI Ultraviolet systems.
-	  If you don't have one of these, you should say N here.
-
-# Following is an alphabetically sorted list of 32 bit extended platforms
-# Please maintain the alphabetic order if and when there are additions
-
-config X86_GOLDFISH
-	bool "Goldfish (Virtual Platform)"
-	depends on X86_EXTENDED_PLATFORM
-	help
-	  Enable support for the Goldfish virtual platform used primarily
-	  for Android development. Unless you are building for the Android
-	  Goldfish emulator say N here.
-
-config X86_INTEL_CE
-	bool "CE4100 TV platform"
-	depends on PCI
-	depends on PCI_GODIRECT
-	depends on X86_IO_APIC
-	depends on X86_32
-	depends on X86_EXTENDED_PLATFORM
-	select X86_REBOOTFIXUPS
-	select OF
-	select OF_EARLY_FLATTREE
-	help
-	  Select for the Intel CE media processor (CE4100) SOC.
-	  This option compiles in support for the CE4100 SOC for settop
-	  boxes and media devices.
-
-config X86_INTEL_MID
-	bool "Intel MID platform support"
-	depends on X86_EXTENDED_PLATFORM
-	depends on X86_PLATFORM_DEVICES
-	depends on PCI
-	depends on X86_64 || (PCI_GOANY && X86_32)
-	depends on X86_IO_APIC
-	select I2C
-	select DW_APB_TIMER
-	select INTEL_SCU_PCI
-	help
-	  Select to build a kernel capable of supporting Intel MID (Mobile
-	  Internet Device) platform systems which do not have the PCI legacy
-	  interfaces. If you are building for a PC class system say N here.
-
-	  Intel MID platforms are based on an Intel processor and chipset which
-	  consume less power than most of the x86 derivatives.
-
-config X86_INTEL_QUARK
-	bool "Intel Quark platform support"
-	depends on X86_32
-	depends on X86_EXTENDED_PLATFORM
-	depends on X86_PLATFORM_DEVICES
-	depends on X86_TSC
-	depends on PCI
-	depends on PCI_GOANY
-	depends on X86_IO_APIC
-	select IOSF_MBI
-	select INTEL_IMR
-	select COMMON_CLK
-	help
-	  Select to include support for Quark X1000 SoC.
-	  Say Y here if you have a Quark based system such as the Arduino
-	  compatible Intel Galileo.
-
-config X86_INTEL_LPSS
-	bool "Intel Low Power Subsystem Support"
-	depends on X86 && ACPI && PCI
-	select COMMON_CLK
-	select PINCTRL
-	select IOSF_MBI
-	help
-	  Select to build support for Intel Low Power Subsystem such as
-	  found on Intel Lynxpoint PCH. Selecting this option enables
-	  things like clock tree (common clock framework) and pincontrol
-	  which are needed by the LPSS peripheral drivers.
-
-config X86_AMD_PLATFORM_DEVICE
-	bool "AMD ACPI2Platform devices support"
-	depends on ACPI
-	select COMMON_CLK
-	select PINCTRL
-	help
-	  Select to interpret AMD specific ACPI device to platform device
-	  such as I2C, UART, GPIO found on AMD Carrizo and later chipsets.
-	  I2C and UART depend on COMMON_CLK to set clock. GPIO driver is
-	  implemented under PINCTRL subsystem.
-
-config IOSF_MBI
-	tristate "Intel SoC IOSF Sideband support for SoC platforms"
-	depends on PCI
-	help
-	  This option enables sideband register access support for Intel SoC
-	  platforms. On these platforms the IOSF sideband is used in lieu of
-	  MSR's for some register accesses, mostly but not limited to thermal
-	  and power. Drivers may query the availability of this device to
-	  determine if they need the sideband in order to work on these
-	  platforms. The sideband is available on the following SoC products.
-	  This list is not meant to be exclusive.
-	   - BayTrail
-	   - Braswell
-	   - Quark
-
-	  You should say Y if you are running a kernel on one of these SoC's.
-
-config IOSF_MBI_DEBUG
-	bool "Enable IOSF sideband access through debugfs"
-	depends on IOSF_MBI && DEBUG_FS
-	help
-	  Select this option to expose the IOSF sideband access registers (MCR,
-	  MDR, MCRX) through debugfs to write and read register information from
-	  different units on the SoC. This is most useful for obtaining device
-	  state information for debug and analysis. As this is a general access
-	  mechanism, users of this option would have specific knowledge of the
-	  device they want to access.
-
-	  If you don't require the option or are in doubt, say N.
-
-config X86_RDC321X
-	bool "RDC R-321x SoC"
-	depends on X86_32
-	depends on X86_EXTENDED_PLATFORM
-	select M486
-	select X86_REBOOTFIXUPS
-	help
-	  This option is needed for RDC R-321x system-on-chip, also known
-	  as R-8610-(G).
-	  If you don't have one of these chips, you should say N here.
-
-config X86_32_NON_STANDARD
-	bool "Support non-standard 32-bit SMP architectures"
-	depends on X86_32 && SMP
-	depends on X86_EXTENDED_PLATFORM
-	help
-	  This option compiles in the bigsmp and STA2X11 default
-	  subarchitectures.  It is intended for a generic binary
-	  kernel. If you select them all, kernel will probe it one by
-	  one and will fallback to default.
-
-# Alphabetically sorted list of Non standard 32 bit platforms
+source "arch/x86/Kconfig.platforms"
 
 config X86_SUPPORTS_MEMORY_FAILURE
 	def_bool y
@@ -745,32 +536,6 @@ config X86_SUPPORTS_MEMORY_FAILURE
 	depends on X86_64 || !SPARSEMEM
 	select ARCH_SUPPORTS_MEMORY_FAILURE
 
-config STA2X11
-	bool "STA2X11 Companion Chip Support"
-	depends on X86_32_NON_STANDARD && PCI
-	select SWIOTLB
-	select MFD_STA2X11
-	select GPIOLIB
-	help
-	  This adds support for boards based on the STA2X11 IO-Hub,
-	  a.k.a. "ConneXt". The chip is used in place of the standard
-	  PC chipset, so all "standard" peripherals are missing. If this
-	  option is selected the kernel will still be able to boot on
-	  standard PC machines.
-
-config X86_32_IRIS
-	tristate "Eurobraille/Iris poweroff module"
-	depends on X86_32
-	help
-	  The Iris machines from EuroBraille do not have APM or ACPI support
-	  to shut themselves down properly.  A special I/O sequence is
-	  needed to do so, which is what this module does at
-	  kernel shutdown.
-
-	  This is only for Iris machines from EuroBraille.
-
-	  If unused, say N.
-
 config SCHED_OMIT_FRAME_POINTER
 	def_bool y
 	prompt "Single-depth WCHAN output"
@@ -1007,8 +772,7 @@ config NR_CPUS_RANGE_BEGIN
 config NR_CPUS_RANGE_END
 	int
 	depends on X86_32
-	default   64 if  SMP &&  X86_BIGSMP
-	default    8 if  SMP && !X86_BIGSMP
+	default    8 if  SMP
 	default    1 if !SMP
 
 config NR_CPUS_RANGE_END
@@ -1021,7 +785,6 @@ config NR_CPUS_RANGE_END
 config NR_CPUS_DEFAULT
 	int
 	depends on X86_32
-	default   32 if  X86_BIGSMP
 	default    8 if  SMP
 	default    1 if !SMP
 
@@ -1097,7 +860,7 @@ config UP_LATE_INIT
 config X86_UP_APIC
 	bool "Local APIC support on uniprocessors" if !PCI_MSI
 	default PCI_MSI
-	depends on X86_32 && !SMP && !X86_32_NON_STANDARD
+	depends on X86_32 && !SMP
 	help
 	  A local APIC (Advanced Programmable Interrupt Controller) is an
 	  integrated interrupt controller in the CPU. If you have a single-CPU
@@ -1122,7 +885,7 @@ config X86_UP_IOAPIC
 
 config X86_LOCAL_APIC
 	def_bool y
-	depends on X86_64 || SMP || X86_32_NON_STANDARD || X86_UP_APIC || PCI_MSI
+	depends on X86_64 || SMP || X86_UP_APIC || PCI_MSI
 	select IRQ_DOMAIN_HIERARCHY
 
 config ACPI_MADT_WAKEUP
@@ -1300,39 +1063,6 @@ config X86_IOPL_IOPERM
 	  ability to disable interrupts from user space which would be
 	  granted if the hardware IOPL mechanism would be used.
 
-config TOSHIBA
-	tristate "Toshiba Laptop support"
-	depends on X86_32
-	help
-	  This adds a driver to safely access the System Management Mode of
-	  the CPU on Toshiba portables with a genuine Toshiba BIOS. It does
-	  not work on models with a Phoenix BIOS. The System Management Mode
-	  is used to set the BIOS and power saving options on Toshiba portables.
-
-	  For information on utilities to make use of this driver see the
-	  Toshiba Linux utilities web site at:
-	  <http://www.buzzard.org.uk/toshiba/>.
-
-	  Say Y if you intend to run this kernel on a Toshiba portable.
-	  Say N otherwise.
-
-config X86_REBOOTFIXUPS
-	bool "Enable X86 board specific fixups for reboot"
-	depends on X86_32
-	help
-	  This enables chipset and/or board specific fixups to be done
-	  in order to get reboot to work correctly. This is only needed on
-	  some combinations of hardware and BIOS. The symptom, for which
-	  this config is intended, is when reboot ends with a stalled/hung
-	  system.
-
-	  Currently, the only fixup is for the Geode machines using
-	  CS5530A and CS5536 chipsets and the RDC R-321x SoC.
-
-	  Say Y if you want to enable the fixup. Currently, it's safe to
-	  enable this option even if you don't need it.
-	  Say N otherwise.
-
 config MICROCODE
 	def_bool y
 	depends on CPU_SUP_AMD || CPU_SUP_INTEL
@@ -1390,15 +1120,11 @@ config X86_CPUID
 	  with major 203 and minors 0 to 31 for /dev/cpu/0/cpuid to
 	  /dev/cpu/31/cpuid.
 
-choice
-	prompt "High Memory Support"
-	default HIGHMEM4G
+config HIGHMEM4G
+	bool "High Memory Support"
 	depends on X86_32
-
-config NOHIGHMEM
-	bool "off"
 	help
-	  Linux can use up to 64 Gigabytes of physical memory on x86 systems.
+	  Linux can use up to 4 Gigabytes of physical memory on x86 systems.
 	  However, the address space of 32-bit x86 processors is only 4
 	  Gigabytes large. That means that, if you have a large amount of
 	  physical memory, not all of it can be "permanently mapped" by the
@@ -1414,38 +1140,9 @@ config NOHIGHMEM
 	  possible.
 
 	  If the machine has between 1 and 4 Gigabytes physical RAM, then
-	  answer "4GB" here.
-
-	  If more than 4 Gigabytes is used then answer "64GB" here. This
-	  selection turns Intel PAE (Physical Address Extension) mode on.
-	  PAE implements 3-level paging on IA32 processors. PAE is fully
-	  supported by Linux, PAE mode is implemented on all recent Intel
-	  processors (Pentium Pro and better). NOTE: If you say "64GB" here,
-	  then the kernel will not boot on CPUs that don't support PAE!
+	  answer "Y" here.
 
-	  The actual amount of total physical memory will either be
-	  auto detected or can be forced by using a kernel command line option
-	  such as "mem=256M". (Try "man bootparam" or see the documentation of
-	  your boot loader (lilo or loadlin) about how to pass options to the
-	  kernel at boot time.)
-
-	  If unsure, say "off".
-
-config HIGHMEM4G
-	bool "4GB"
-	help
-	  Select this if you have a 32-bit processor and between 1 and 4
-	  gigabytes of physical RAM.
-
-config HIGHMEM64G
-	bool "64GB"
-	depends on X86_HAVE_PAE
-	select X86_PAE
-	help
-	  Select this if you have a 32-bit processor and more than 4
-	  gigabytes of physical RAM.
-
-endchoice
+	  If unsure, say N.
 
 choice
 	prompt "Memory split" if EXPERT
@@ -1491,14 +1188,11 @@ config PAGE_OFFSET
 	depends on X86_32
 
 config HIGHMEM
-	def_bool y
-	depends on X86_32 && (HIGHMEM64G || HIGHMEM4G)
+	def_bool HIGHMEM4G
 
 config X86_PAE
 	bool "PAE (Physical Address Extension) Support"
 	depends on X86_32 && X86_HAVE_PAE
-	select PHYS_ADDR_T_64BIT
-	select SWIOTLB
 	help
 	  PAE is required for NX support, and furthermore enables
 	  larger swapspace support for non-overcommit purposes. It
@@ -1567,8 +1261,7 @@ config AMD_MEM_ENCRYPT
 config NUMA
 	bool "NUMA Memory Allocation and Scheduler Support"
 	depends on SMP
-	depends on X86_64 || (X86_32 && HIGHMEM64G && X86_BIGSMP)
-	default y if X86_BIGSMP
+	depends on X86_64
 	select USE_PERCPU_NUMA_NODE_ID
 	select OF_NUMA if OF
 	help
@@ -1581,9 +1274,6 @@ config NUMA
 	  For 64-bit this is recommended if the system is Intel Core i7
 	  (or later), AMD Opteron, or EM64T NUMA.
 
-	  For 32-bit this is only needed if you boot a 32-bit
-	  kernel on a 64-bit NUMA platform.
-
 	  Otherwise, you should say N.
 
 config AMD_NUMA
@@ -1622,7 +1312,7 @@ config ARCH_FLATMEM_ENABLE
 
 config ARCH_SPARSEMEM_ENABLE
 	def_bool y
-	depends on X86_64 || NUMA || X86_32 || X86_32_NON_STANDARD
+	depends on X86_64 || NUMA || X86_32
 	select SPARSEMEM_STATIC if X86_32
 	select SPARSEMEM_VMEMMAP_ENABLE if X86_64
 
@@ -1668,15 +1358,6 @@ config X86_PMEM_LEGACY
 
 	  Say Y if unsure.
 
-config HIGHPTE
-	bool "Allocate 3rd-level pagetables from highmem"
-	depends on HIGHMEM
-	help
-	  The VM uses one page table entry for each page of physical memory.
-	  For systems with a lot of RAM, this can be wasteful of precious
-	  low memory.  Setting this option will put user-space page table
-	  entries in high memory.
-
 config X86_CHECK_BIOS_CORRUPTION
 	bool "Check for low memory corruption"
 	help
@@ -3001,10 +2682,9 @@ config ISA_DMA_API
 	  Enables ISA-style DMA support for devices requiring such controllers.
 	  If unsure, say Y.
 
-if X86_32
-
 config ISA
 	bool "ISA support"
+	depends on X86_32
 	help
 	  Find out whether you have ISA slots on your motherboard.  ISA is the
 	  name of a bus system, i.e. the way the CPU talks to the other stuff
@@ -3012,120 +2692,6 @@ config ISA
 	  (MCA) or VESA.  ISA is an older system, now being displaced by PCI;
 	  newer boards don't support it.  If you have ISA, say Y, otherwise N.
 
-config SCx200
-	tristate "NatSemi SCx200 support"
-	help
-	  This provides basic support for National Semiconductor's
-	  (now AMD's) Geode processors.  The driver probes for the
-	  PCI-IDs of several on-chip devices, so its a good dependency
-	  for other scx200_* drivers.
-
-	  If compiled as a module, the driver is named scx200.
-
-config SCx200HR_TIMER
-	tristate "NatSemi SCx200 27MHz High-Resolution Timer Support"
-	depends on SCx200
-	default y
-	help
-	  This driver provides a clocksource built upon the on-chip
-	  27MHz high-resolution timer.  Its also a workaround for
-	  NSC Geode SC-1100's buggy TSC, which loses time when the
-	  processor goes idle (as is done by the scheduler).  The
-	  other workaround is idle=poll boot option.
-
-config OLPC
-	bool "One Laptop Per Child support"
-	depends on !X86_PAE
-	select GPIOLIB
-	select OF
-	select OF_PROMTREE
-	select IRQ_DOMAIN
-	select OLPC_EC
-	help
-	  Add support for detecting the unique features of the OLPC
-	  XO hardware.
-
-config OLPC_XO1_PM
-	bool "OLPC XO-1 Power Management"
-	depends on OLPC && MFD_CS5535=y && PM_SLEEP
-	help
-	  Add support for poweroff and suspend of the OLPC XO-1 laptop.
-
-config OLPC_XO1_RTC
-	bool "OLPC XO-1 Real Time Clock"
-	depends on OLPC_XO1_PM && RTC_DRV_CMOS
-	help
-	  Add support for the XO-1 real time clock, which can be used as a
-	  programmable wakeup source.
-
-config OLPC_XO1_SCI
-	bool "OLPC XO-1 SCI extras"
-	depends on OLPC && OLPC_XO1_PM && GPIO_CS5535=y
-	depends on INPUT=y
-	select POWER_SUPPLY
-	help
-	  Add support for SCI-based features of the OLPC XO-1 laptop:
-	   - EC-driven system wakeups
-	   - Power button
-	   - Ebook switch
-	   - Lid switch
-	   - AC adapter status updates
-	   - Battery status updates
-
-config OLPC_XO15_SCI
-	bool "OLPC XO-1.5 SCI extras"
-	depends on OLPC && ACPI
-	select POWER_SUPPLY
-	help
-	  Add support for SCI-based features of the OLPC XO-1.5 laptop:
-	   - EC-driven system wakeups
-	   - AC adapter status updates
-	   - Battery status updates
-
-config GEODE_COMMON
-	bool
-
-config ALIX
-	bool "PCEngines ALIX System Support (LED setup)"
-	select GPIOLIB
-	select GEODE_COMMON
-	help
-	  This option enables system support for the PCEngines ALIX.
-	  At present this just sets up LEDs for GPIO control on
-	  ALIX2/3/6 boards.  However, other system specific setup should
-	  get added here.
-
-	  Note: You must still enable the drivers for GPIO and LED support
-	  (GPIO_CS5535 & LEDS_GPIO) to actually use the LEDs
-
-	  Note: You have to set alix.force=1 for boards with Award BIOS.
-
-config NET5501
-	bool "Soekris Engineering net5501 System Support (LEDS, GPIO, etc)"
-	select GPIOLIB
-	select GEODE_COMMON
-	help
-	  This option enables system support for the Soekris Engineering net5501.
-
-config GEOS
-	bool "Traverse Technologies GEOS System Support (LEDS, GPIO, etc)"
-	select GPIOLIB
-	select GEODE_COMMON
-	depends on DMI
-	help
-	  This option enables system support for the Traverse Technologies GEOS.
-
-config TS5500
-	bool "Technologic Systems TS-5500 platform support"
-	depends on MELAN
-	select CHECK_SIGNATURE
-	select NEW_LEDS
-	select LEDS_CLASS
-	help
-	  This option enables system support for the Technologic Systems TS-5500.
-
-endif # X86_32
-
 config AMD_NB
 	def_bool y
 	depends on CPU_SUP_AMD && PCI
```
